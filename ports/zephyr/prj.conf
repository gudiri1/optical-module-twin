## CMakeLists.txt
```
# SPDX-License-Identifier: Apache-2.0
# Zephyr port of the module controller firmware.
#   west build -b native_sim ports/zephyr        (bring-up smoke test)
#   west build -b <your_mcu_board> ports/zephyr  (real hardware, see boards/README)
cmake_minimum_required(VERSION 3.20.0)
find_package(Zephyr REQUIRED HINTS $ENV{ZEPHYR_BASE})
project(omt_module_fw C)

set(OMT_FW ${CMAKE_CURRENT_SOURCE_DIR}/../../firmware)
file(GLOB OMT_FW_SRC ${OMT_FW}/src/*.c)
target_sources(app PRIVATE ${OMT_FW_SRC} src/main.c src/hal_zephyr.c)
target_include_directories(app PRIVATE ${OMT_FW}/include)
```

## Kconfig
```
# SPDX-License-Identifier: Apache-2.0
mainmenu "Optical Module Twin firmware"

config OMT_HOST_SELFTEST
	bool "Run a host-side CMIS bring-up from a thread (no I2C target hardware)"
	help
	  native_sim has no I2C target controller; a thread plays the host and
	  drives the CMIS interface through the same entry points the I2C
	  target callbacks use on hardware.

config OMT_TICK_MS
	int "Firmware scheduler tick"
	default 1

source "Kconfig.zephyr"
```

## prj.conf
```kconfig
# SPDX-License-Identifier: Apache-2.0
CONFIG_FLASH=y
CONFIG_FLASH_MAP=y
CONFIG_GPIO=y
CONFIG_WATCHDOG=n
CONFIG_SHELL=y
CONFIG_PRINTK=y
CONFIG_HWINFO=y
CONFIG_REBOOT=y
CONFIG_MAIN_STACK_SIZE=4096
CONFIG_OMT_HOST_SELFTEST=y
```

## boards/native_sim.overlay
```dts
/* SPDX-License-Identifier: Apache-2.0 */
/* The firmware NVM layout needs 64 KiB of 4 KiB sectors. */
/ {
	chosen {
		omt,nvm = &scratch_partition;
	};
};
```

## src/main.c
```c
/*
 * Zephyr application: firmware scheduler thread, CMIS host interface
 * (I2C target on hardware, a self-test thread on native_sim) and a shell
 * bridge to the firmware's UART console.
 *
 * SPDX-License-Identifier: Apache-2.0
 */
#include <stdlib.h>
#include <string.h>
#include <zephyr/kernel.h>
#include <zephyr/version.h>
#include <zephyr/shell/shell.h>
#include <zephyr/sys/printk.h>

#include "omt/fw.h"

extern const struct omt_hal omt_zephyr_hal;
int omt_zephyr_hal_init(void);

static struct omt_fw fw;

#if DT_HAS_CHOSEN(omt_host_i2c)
#include <zephyr/drivers/i2c.h>
/* Byte-wise I2C target callbacks mapped onto omt_i2c_write/read. */
static uint8_t wbuf[130];
static size_t wlen;
static int t_write_requested(struct i2c_target_config *c) { ARG_UNUSED(c); wlen = 0; return 0; }
static int t_write_received(struct i2c_target_config *c, uint8_t v)
{
	ARG_UNUSED(c);
	if (wlen < sizeof(wbuf)) {
		wbuf[wlen++] = v;
	}
	return 0;
}
static int t_read_requested(struct i2c_target_config *c, uint8_t *v)
{
	ARG_UNUSED(c);
	if (wlen) {             /* address-only write before a repeated start */
		omt_i2c_write(&fw, wbuf, wlen);
		wlen = 0;
	}
	return omt_i2c_read(&fw, v, 1);
}
static int t_read_processed(struct i2c_target_config *c, uint8_t *v)
{
	ARG_UNUSED(c);
	return omt_i2c_read(&fw, v, 1);
}
static int t_stop(struct i2c_target_config *c)
{
	ARG_UNUSED(c);
	if (wlen) {
		omt_i2c_write(&fw, wbuf, wlen);
		wlen = 0;
	}
	return 0;
}
static const struct i2c_target_callbacks tcb = {
	.write_requested = t_write_requested, .write_received = t_write_received,
	.read_requested = t_read_requested, .read_processed = t_read_processed, .stop = t_stop,
};
static struct i2c_target_config tcfg = { .address = 0x50, .callbacks = &tcb };
#endif

static void fw_thread(void *a, void *b, void *c)
{
	ARG_UNUSED(a); ARG_UNUSED(b); ARG_UNUSED(c);
	while (1) {
		omt_fw_tick(&fw);
		k_msleep(CONFIG_OMT_TICK_MS);
	}
}
K_THREAD_DEFINE(omt_fw_tid, 4096, fw_thread, NULL, NULL, NULL, 5, 0, 100);

#ifdef CONFIG_OMT_HOST_SELFTEST
static uint8_t host_rd(uint8_t off)
{
	uint8_t v;

	omt_i2c_write(&fw, &off, 1);
	omt_i2c_read(&fw, &v, 1);
	return v;
}

static void host_thread(void *a, void *b, void *c)
{
	static const char *const st[] = { "MgmtInit", "LowPwr", "PwrUp", "Ready", "PwrDn", "Fault" };
	const uint8_t up[2] = { CMIS_MOD_CTRL, 0x00 };

	ARG_UNUSED(a); ARG_UNUSED(b); ARG_UNUSED(c);
	k_msleep(200);
	printk("host: id 0x%02X cmis %u.%u state %s fw %u.%u\n", host_rd(0), host_rd(1) >> 4,
	       host_rd(1) & 0xF, st[(host_rd(3) >> 1) & 7], host_rd(39), host_rd(40));
	omt_i2c_write(&fw, up, sizeof(up));   /* clear LowPwr requests */
	k_msleep(600);
	uint8_t s = (host_rd(3) >> 1) & 7;

	printk("host: after power-up request state %s, fault cause %u\n", st[s < 6 ? s : 0], host_rd(41));
	printk("host: done\n");
}
K_THREAD_DEFINE(omt_host_tid, 2048, host_thread, NULL, NULL, NULL, 4, 0, 300);
#endif

static int cmd_omt(const struct shell *sh, size_t argc, char **argv)
{
	char line[96] = { 0 };

	for (size_t i = 1; i < argc; i++) {
		strncat(line, argv[i], sizeof(line) - strlen(line) - 2);
		strcat(line, i + 1 < argc ? " " : "\n");
	}
	omt_console_rx(&fw, line, strlen(line));
	return 0;
}
SHELL_CMD_ARG_REGISTER(omt, NULL, "firmware console: omt <help|ver|state|mon|faults ...>", cmd_omt, 2, 6);

int main(void)
{
	int rc = omt_zephyr_hal_init();

	printk("omt: module controller firmware on Zephyr %s, NVM %s\n", KERNEL_VERSION_STRING,
	       rc ? "unavailable" : "ok");
	omt_fw_init(&fw, &omt_zephyr_hal);
#if DT_HAS_CHOSEN(omt_host_i2c)
	(void)i2c_target_register(DEVICE_DT_GET(DT_CHOSEN(omt_host_i2c)), &tcfg);
#endif
	return 0;
}
```

## src/hal_zephyr.c
```c
/*
 * Zephyr implementation of struct omt_hal.
 *
 * Every peripheral is optional in devicetree; missing ones return -ENODEV so
 * the same image runs on native_sim (flash only) and on a full board.
 *
 * SPDX-License-Identifier: Apache-2.0
 */
#include <errno.h>
#include <zephyr/drivers/hwinfo.h>
#include <zephyr/kernel.h>
#include <zephyr/storage/flash_map.h>
#include <zephyr/sys/printk.h>
#include <zephyr/sys/reboot.h>

#if DT_NODE_EXISTS(DT_NODELABEL(omt_laser))
#include <zephyr/drivers/spi.h>
static const struct spi_dt_spec laser = SPI_DT_SPEC_GET(DT_NODELABEL(omt_laser),
							 SPI_WORD_SET(8) | SPI_TRANSFER_MSB, 0);
#endif
#if DT_NODE_EXISTS(DT_NODELABEL(omt_mdio))
#include <zephyr/drivers/mdio.h>
static const struct device *const mdio = DEVICE_DT_GET(DT_NODELABEL(omt_mdio));
#endif
#if DT_NODE_EXISTS(DT_ALIAS(watchdog0))
#include <zephyr/drivers/watchdog.h>
static const struct device *const wdt = DEVICE_DT_GET(DT_ALIAS(watchdog0));
static int wdt_ch = -1;
#endif

#include "omt/fw.h"

/* Pins without a devicetree binding are kept virtual (native_sim). */
static int vpin[OMT_PIN_COUNT] = { [OMT_PIN_LPMODE] = 1, [OMT_PIN_RESETL] = 1, [OMT_PIN_INTL] = 1 };
static const struct flash_area *nvm;
static unsigned int irq_key;
static int irq_depth;

static uint32_t z_millis(void *ctx)
{
	ARG_UNUSED(ctx);
	return k_uptime_get_32();
}

static uint8_t z_reset_cause(void *ctx)
{
	uint32_t c = 0;

	ARG_UNUSED(ctx);
	if (hwinfo_get_reset_cause(&c) != 0) {
		return OMT_RST_POWER_ON;
	}
	(void)hwinfo_clear_reset_cause();
	if (c & RESET_WATCHDOG) {
		return OMT_RST_WATCHDOG;
	}
	if (c & RESET_SOFTWARE) {
		return OMT_RST_SOFTWARE;
	}
	if (c & RESET_PIN) {
		return OMT_RST_HOST_PIN;
	}
	return OMT_RST_POWER_ON;
}

static int z_spi(void *ctx, const uint8_t *tx, uint8_t *rx, size_t len)
{
	ARG_UNUSED(ctx);
#if DT_NODE_EXISTS(DT_NODELABEL(omt_laser))
	const struct spi_buf tb = { .buf = (void *)tx, .len = len }, rb = { .buf = rx, .len = len };
	const struct spi_buf_set ts = { &tb, 1 }, rs = { &rb, 1 };

	return spi_transceive_dt(&laser, &ts, &rs);
#else
	ARG_UNUSED(tx);
	memset(rx, 0xFF, len); /* no laser driver: bus floats high */
	return 0;
#endif
}

static int z_mdio_read(void *ctx, uint8_t prtad, uint8_t devad, uint16_t reg, uint16_t *val)
{
	ARG_UNUSED(ctx);
#if DT_NODE_EXISTS(DT_NODELABEL(omt_mdio))
	return mdio_read_c45(mdio, prtad, devad, reg, val);
#else
	ARG_UNUSED(prtad); ARG_UNUSED(devad); ARG_UNUSED(reg); ARG_UNUSED(val);
	return -ENODEV;
#endif
}

static int z_mdio_write(void *ctx, uint8_t prtad, uint8_t devad, uint16_t reg, uint16_t val)
{
	ARG_UNUSED(ctx);
#if DT_NODE_EXISTS(DT_NODELABEL(omt_mdio))
	return mdio_write_c45(mdio, prtad, devad, reg, val);
#else
	ARG_UNUSED(prtad); ARG_UNUSED(devad); ARG_UNUSED(reg); ARG_UNUSED(val);
	return -ENODEV;
#endif
}

static int z_adc(void *ctx, uint8_t ch, uint16_t *raw)
{
	ARG_UNUSED(ctx);
	/* Board ports bind zephyr,user io-channels here (adc_read_dt). Without
	 * an ADC report a mid-scale reading: 25 degC sensors, 3.3 V supply. */
	static const uint16_t idle[OMT_ADC_COUNT] = { 19661, 43253, 200, 200, 200, 200, 19661, 32768 };

	*raw = ch < OMT_ADC_COUNT ? idle[ch] : 0;
	return 0;
}

static int z_dac(void *ctx, uint8_t ch, uint16_t val)
{
	ARG_UNUSED(ctx); ARG_UNUSED(ch); ARG_UNUSED(val);
	return 0;
}

static int z_gpio_get(void *ctx, uint8_t pin)
{
	ARG_UNUSED(ctx);
	return pin < OMT_PIN_COUNT ? vpin[pin] : 0;
}

static void z_gpio_set(void *ctx, uint8_t pin, int level)
{
	ARG_UNUSED(ctx);
	if (pin < OMT_PIN_COUNT) {
		vpin[pin] = level;
	}
}

static int z_nvm_read(void *ctx, uint32_t addr, void *buf, size_t len)
{
	ARG_UNUSED(ctx);
	return nvm ? flash_area_read(nvm, addr, buf, len) : -ENODEV;
}

static int z_nvm_write(void *ctx, uint32_t addr, const void *buf, size_t len)
{
	ARG_UNUSED(ctx);
	return nvm ? flash_area_write(nvm, addr, buf, len) : -ENODEV;
}

static int z_nvm_erase(void *ctx, uint32_t addr, size_t len)
{
	ARG_UNUSED(ctx);
	return nvm ? flash_area_erase(nvm, addr, len) : -ENODEV;
}

static void z_kick(void *ctx)
{
	ARG_UNUSED(ctx);
#if DT_NODE_EXISTS(DT_ALIAS(watchdog0))
	if (wdt_ch >= 0) {
		(void)wdt_feed(wdt, wdt_ch);
	}
#endif
}

static void z_uart(void *ctx, const char *s, size_t n)
{
	ARG_UNUSED(ctx);
	printk("%.*s", (int)n, s);
}

static void z_reset(void *ctx, uint8_t cause)
{
	ARG_UNUSED(ctx);
	printk("omt: reset requested (cause %u)\n", cause);
	sys_reboot(SYS_REBOOT_COLD);
}

/* The CMIS I2C target ISR must not observe half-updated multi-byte values. */
static void z_lock(void *ctx)
{
	ARG_UNUSED(ctx);
	unsigned int k = irq_lock();

	if (irq_depth++ == 0) {
		irq_key = k;
	}
}

static void z_unlock(void *ctx)
{
	ARG_UNUSED(ctx);
	if (--irq_depth == 0) {
		irq_unlock(irq_key);
	}
}

const struct omt_hal omt_zephyr_hal = {
	.millis = z_millis, .reset_cause = z_reset_cause, .spi_xfer = z_spi,
	.mdio_read = z_mdio_read, .mdio_write = z_mdio_write, .adc_read = z_adc,
	.dac_write = z_dac, .gpio_get = z_gpio_get, .gpio_set = z_gpio_set,
	.nvm_read = z_nvm_read, .nvm_write = z_nvm_write, .nvm_erase = z_nvm_erase,
	.wdt_kick = z_kick, .uart_tx = z_uart, .system_reset = z_reset,
	.irq_lock = z_lock, .irq_unlock = z_unlock,
};

int omt_zephyr_hal_init(void)
{
	int rc = flash_area_open(DT_FIXED_PARTITION_ID(DT_CHOSEN(omt_nvm)), &nvm);

	if (rc == 0 && nvm->fa_size < OMT_NVM_SIZE) {
		printk("omt: NVM partition too small (%zu < %u)\n", nvm->fa_size, OMT_NVM_SIZE);
		nvm = NULL;
		return -ENOSPC;
	}
#if DT_NODE_EXISTS(DT_ALIAS(watchdog0))
	struct wdt_timeout_cfg cfg = { .window.max = 300, .flags = WDT_FLAG_RESET_SOC };

	wdt_ch = wdt_install_timeout(wdt, &cfg);
	if (wdt_ch >= 0) {
		(void)wdt_setup(wdt, WDT_OPT_PAUSE_HALTED_BY_DBG);
	}
#endif
	return rc;
}
```
